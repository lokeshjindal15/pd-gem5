## kernel_dvfs/linux-linaro-tracking-gem5/drivers/cpuidle/Kconfig
```kconfig
menu "CPU Idle"

config CPU_IDLE
	bool "CPU idle PM support"
	default y if ACPI || PPC_PSERIES
	select CPU_IDLE_GOV_LADDER if (!NO_HZ && !NO_HZ_IDLE)
	select CPU_IDLE_GOV_MENU if (NO_HZ || NO_HZ_IDLE)
	help
	  CPU idle is a generic framework for supporting software-controlled
	  idle processor power management.  It includes modular cross-platform
	  governors that can be swapped during runtime.

	  If you're using an ACPI-enabled platform, you should say Y here.

if CPU_IDLE

config CPU_IDLE_MULTIPLE_DRIVERS
        bool "Support multiple cpuidle drivers"
        default n
        help
         Allows the cpuidle framework to use different drivers for each CPU.
         This is useful if you have a system with different CPU latencies and
         states. If unsure say N.

config CPU_IDLE_GOV_LADDER
	bool "Ladder governor (for periodic timer tick)"
	default y

config CPU_IDLE_GOV_MENU
	bool "Menu governor (for tickless system)"
	default y

menu "ARM CPU Idle Drivers"
config ARM_BIG_LITTLE_CPUIDLE
        bool "Support for ARM big.LITTLE processors"
        select ARM_CPU_SUSPEND
        select CPU_IDLE_MULTIPLE_DRIVERS
        help
          Select this option to enable CPU idle driver for big.LITTLE based
          ARM systems. Driver manages CPUs coordination through MCPM and 
          define different C-states for little and big cores through the 
          multiple CPU idle drivers infrastructure.

config ARM_HIGHBANK_CPUIDLE
        bool "CPU Idle Driver for Calxeda processors"
        depends on ARM_PSCI
        select ARM_CPU_SUSPEND
        help
          Select this to enable cpuidle on Calxeda processors.

config ARM_KIRKWOOD_CPUIDLE
        bool "CPU Idle Driver for Marvell Kirkwood SoCs"
        depends on ARCH_KIRKWOOD
        help
          This adds the CPU Idle driver for Marvell Kirkwood SoCs.

config ARM_ZYNQ_CPUIDLE
        bool "CPU Idle Driver for Xilinx Zynq processors"
        depends on ARCH_ZYNQ
        help
          Select this to enable cpuidle on Xilinx Zynq processors.

config ARM_U8500_CPUIDLE
        bool "Cpu Idle Driver for the ST-E u8500 processors"
        depends on ARCH_U8500
        help
          Select this to enable cpuidle for ST-E u8500 processors

config ARM_AT91_CPUIDLE
        bool "Cpu Idle Driver for the AT91 processors"
        default y
        depends on ARCH_AT91
        help
          Select this to enable cpuidle for AT91 processors


endmenu

menu "POWERPC CPU Idle Drivers"
depends on PPC
source "drivers/cpuidle/Kconfig.powerpc"
endmenu

endif

config ARCH_NEEDS_CPU_IDLE_COUPLED
	def_bool n
endmenu
```
